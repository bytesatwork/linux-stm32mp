// SPDX-License-Identifier: GPL-2.0
/*
 *  Copyright (C) 2022 bytes at work AG - http://www.bytesatwork.ch
 */

/dts-v1/;

#include "stm32mp157c-bytedevkit.dtsi"

/ {
	model = "byteDEVKIT V1.1";
	compatible = "batw,bytedevkit", "batw,m5", "st,stm32mp157";
};

&ethernet0 {
	status = "okay";
	pinctrl-0 = <&ethernet0_rgmii_pins>;
	pinctrl-names = "default";
	phy-mode = "rgmii-id";
	phy-handle = <&phy0>;
	st,eth-clk-sel = <1>;
	max-speed = <1000>;
	clock-names = "stmmaceth", "mac-clk-tx", "mac-clk-rx", "eth-ck", "syscfg-clk", "ethstp";
	clocks = <&rcc ETHMAC>, <&rcc ETHTX>, <&rcc ETHRX>, <&rcc ETHCK_K>, <&rcc SYSCFG>,
		 <&rcc ETHSTP>;

	mdio0 {
		#address-cells = <1>;
		#size-cells = <0>;
		compatible = "snps,dwmac-mdio";
		phy0: ethernet-phy@0 {
			reg = <0>;
			ti,rx-internal-delay = <DP83867_RGMIIDCTL_3_00_NS>;
			ti,tx-internal-delay = <DP83867_RGMIIDCTL_2_75_NS>;
			ti,fifo-depth = <DP83867_PHYCR_FIFO_DEPTH_4_B_NIB>;
			ti,dp83867-rxctrl-strap-quirk;
		};
	};
};
