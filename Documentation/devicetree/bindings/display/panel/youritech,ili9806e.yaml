## Documentation/devicetree/bindings/display/panel/youritech,ili9806e.yaml
```yaml
# SPDX-License-Identifier: GPL-2.0-only OR BSD-2-Clause
%YAML 1.2
---
$id: http://devicetree.org/schemas/display/panel/youritech,ili9806e.yaml#
$schema: http://devicetree.org/meta-schemas/core.yaml#

title: MIPI-DSI panel with Youritech ILI9806E Controller

maintainers:
  - Daniel Ammann <daniel.ammann@bytesatwork.ch>

allOf:
  - $ref: panel-common.yaml#

properties:
  compatible:
    const: youritech,ili9806e

  reg: true
  port: true
  reset-gpios: true
  width-mm: true
  height-mm: true

  dsi-lanes:
    description: Number of DSI lanes to be used must be <1> or <2> or <3> or <4>
    enum: [1, 2, 3, 4]

  video-mode:
    description: |
      0 - burst-mode
      1 - non-burst with sync event
      2 - non-burst with sync pulse
      3 - command mode
    $ref: /schemas/types.yaml#/definitions/uint32
    enum: [0, 1, 2, 3]

required:
  - compatible
  - reg
  - dsi-lanes
  - port

additionalProperties: false

examples:
  - |
    &dsi {
      #address-cells = <1>;
      #size-cells = <0>;
      status = "okay";

      panel@0 {
        compatible = "youritech,ili9806e";
        reg = <0>;
        backlight = <&mipi_bl>;
        reset-gpios = <&gpio2 22 GPIO_ACTIVE_HIGH>;
        dsi-lanes = <2>;
        video-mode = <2>;	/* 0: burst mode
              * 1: non-burst mode with sync event
              * 2: non-burst mode with sync pulse
              */
        width-mm = <68>;
        height-mm = <121>;
        status = "okay";

        port {
          panel_mipi_in: endpoint {
            remote-endpoint = <&dsi_out>;
          };
        };
      };

      ports {
        port@1 {
          reg = <1>;

          dsi_out: endpoint {
            remote-endpoint = <&panel_mipi_in>;
          };
        };
      };
    };
...
```
